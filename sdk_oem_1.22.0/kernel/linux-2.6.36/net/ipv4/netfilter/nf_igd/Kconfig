## sdk_oem_1.22.0/kernel/linux-2.6.36/net/ipv4/netfilter/nf_igd/Kconfig
```kconfig
menuconfig  NF_IGD
	bool "nf_igd"
	default y

config NF_MATCH_HTTP
	tristate "http match support"
	depends on NF_IGD
	---help---

config NF_L7
	tristate "l7 match support"
	depends on NF_IGD
	---help---
```
